VIAORA = $6001 ; VIA OUTPUT REGISTER A
VIADDRA = $6003 ; VIA DATA DIRECTION REGISTER A
VIAORB = $6000 ; VIA OUTPUT REGISTER B
VIADDRB = $6002 ; VIA DATA DIRECTION REGISTER B
VI2ORA = $5001 ; VIA 2 ORA
VI2DDRA = $5003 ; VIA 2 DDRA
VI2ORB = $5000 ; VIA 2 ORB
VI2DDRB = $5002 ; VIA 2 DDRB]
VI2PCR = $500C ; VIA2 HANDSHAKE
ACIA_DATA = $4400
ACIA_STATUS = $4401
ACIA_COMMAND = $4402
ACIA_CONTROL = $4403
DROPCOUNT = $0050

; A SIMPLE TERMINAL PROGRAM FOR THE BREADBOARD 6502
; CALLING THIS "SIMTERM" FOR NOW...
; 
; USE WITH LANTRONIX OR TCPSER FOR BBS CONNECTIVITY 
; 
;
; *** 1.0 6/26/19 ***
; WILL ASSUME 1200 8N1 FOR NOW. NO FLOW CONTROL
; 19200 8N1 OF THE MONITOR IS JUST TOO FAST WITH NO FLOW CONTROL
; AND YOUR USB TO SERIAL DOESN'T ALLOW FOR RTS/CTS
 
 *=$8600 
 


UARTREINIT: ; RESETS TELLYMATE TO POWERON STATE. REAUTO BAUD
              
              
              LDA #$1B ; ESCAPE SEQUENCE
              STA ACIA_DATA
              JSR DELAY
              LDA #$7A ; z ESC+z reinitalizes TellyMate, forces to readjust baudrate again
              STA ACIA_DATA
              JSR DELAY
              LDA #@00011000 ; 1 STOP BIT, 8DB, 1200 BAUD
              STA ACIA_CONTROL
	      JSR DELAY
              JSR DELAYL
              JSR DELAYL
              JSR DELAYL
              
 
 
TELLYMATEINIT: ; NOW THAT BAUD RATE IS ADJUSTED, AND TELLYMATE TINY IS TRYING TO ESTABLISH A
               ; A BAUDRATE, WE CONTINUE WITH THE INIT SEQUENCE FOR THE TM.  
               
               LDA #@01010101 ; LDA WITH ASCII U
               STA ACIA_DATA ; PLACE IT ON SCREEN
               JSR DELAY
               STA ACIA_DATA ; DO IT AGAIN JUST TO BE SURE THAT AUTOBAUD HAS INITIATED CORRECTLY
               JSR DELAY ; DELAYS ARE NEEDED HERE!!!
               STA ACIA_DATA
               JSR DELAY
               STA ACIA_DATA
               JSR DELAY
               JSR DELAYL
               LDA #$1B
               STA ACIA_DATA
               JSR DELAYL ; INIT ESC SEQUENCE ON TELLYMATE
               LDA #$45 ; NOW SENDS ESC E TO TELLY MATE, CLEARING
               STA ACIA_DATA
               JSR DELAYL
               LDA #$1B
               STA ACIA_DATA
               JSR DELAYL ; INIT ESC SEQUENCE ON TELLYMATE
               LDA #$34
               STA ACIA_DATA
               JSR DELAYL
               LDA #$1B ; TELLY ESC SEQUENCE
               STA ACIA_DATA
               JSR DELAYL 
               LDA #$76 ; AUTOWRAP ON
               STA ACIA_DATA
               JSR DELAYL
               
MSGST: ; GRABS MESSAGE FROM TEXT, STORES ON SCREEN

        LDY #$00 ; STRING LOCATION
GET:    LDA #@00000111
        STA VIAORB ; DATA REG, E HIGH
        LDA TEXT,Y
        BEQ WAIT
        STA ACIA_DATA ; ALSO STORES ON ACIA FOR TV
        STA VIAORA ; PLACES CURRENT CHAR ON ORA BUS
        LDA #@00000101 ; DATA REG, E LOW. DATA READ
        STA VIAORB
        JSR DELAYL  
        INY
        JMP GET
                    

TEXT: .BYTE "SIMTERM 1.5, 2021" , $0D, "PRESS & TO QUIT AT ANY TIME" , $0D, "PRESS ANY KEY TO CONTINUE..." , $00



WAIT: JSR WAITSCAN

           
SCAN: ; SCANS TO SEE IF KEY HAS BEEN PRESSED

      LDA VIAORB
      CMP #@00000111 ; IS HANDSHAKE PIN LOW?
      BEQ GETKEY ; IT IS. PROCESS KEY
      JMP SCAN ; IT ISN'T. NO KEY PRESSED. KEEP SCANNING.

GETKEY: ; IF KEY IS PRESSED, GET IT AND DISPLAY IT

         LDA VI2ORA ; GRABS PRESSED KEY
         CMP #$26 ; &?
         BEQ MSGQ ; YES. QUIT TIME
         STA ACIA_DATA ; PLACES INTO ACIA. IN THEORY, THIS SENDS IT TO 
                       ; OUR MODEM
         JSR DELAY
         JSR DELAY
         JMP SCAN ; SCAN FOR NEXT KEY PRESS

MSGQ: ; GRABS MESSAGE FROM TEXT, STORES ON SCREEN
        JSR SERIALDROP
        LDY #$00 ; STRING LOCATION
GETQ:   LDA #@00000111
        STA VIAORB ; DATA REG, E HIGH
        LDA TEXTQ,Y
        BEQ QUIT
        STA ACIA_DATA ; ALSO STORES ON ACIA FOR TV
        STA VIAORA ; PLACES CURRENT CHAR ON ORA BUS
        LDA #@00000101 ; DATA REG, E LOW. DATA READ
        STA VIAORB
        
        JSR DELAYL
        INY
        JMP GETQ   

TEXTQ: .BYTE "EXITING TO MONITOR..." , $00

QUIT: JSR DELAYL
      JSR DELAYL
      LDA #$1B ; ESCAPE SEQUENCE
      STA ACIA_DATA
      JSR DELAY
      LDA #$7A ; z ESC+z reinitalizes TellyMate, forces to readjust baudrate again
      STA ACIA_DATA
      JSR DELAY
      JSR DELAYL
      JSR DELAYL
      JSR DELAYL
      JSR DELAYL
      JMP $8000 ; BACK TO MONITOR WITH YE      

     
; GENERAL PURPOSE SUBROUTINES


DELAY:  LDX #0 ; GENERAL PURPOSE SHORT DELAY
DELAY0: DEX
        BNE DELAY0
        RTS


DELAYL: PHY
        LDX #200 ; GENERAL PURPOSE LONG DELAY: ROUGHLY TWICE AS LONG AS SHORT DELAY
delay2: LDY #0
delay1: DEY
        BNE delay1
        DEX
        BNE delay2
        PLY
        RTS
        
        
WAITSCAN: ; SCANS TO SEE IF KEY HAS BEEN PRESSED

         LDA VIAORB
         CMP #@00000111 ; IS HANDSHAKE PIN LOW?
         BEQ WAITRTS ; IT IS. KEY HAS BEEN PRESSED. RTS TO MOVE ON. 
         JMP WAITSCAN ; IT ISN'T. NO KEY PRESSED. KEEP SCANNING.
WAITRTS: RTS


SERIALDROP: 
             LDA #$0A
             STA ACIA_DATA
             JSR DELAY
             LDA #$0D
             STA ACIA_DATA
             JSR DELAY
             LDA #$0A
             STA ACIA_DATA
             JSR DELAY
             LDA #$0D
             STA ACIA_DATA
             JSR DELAY
             RTS   
 